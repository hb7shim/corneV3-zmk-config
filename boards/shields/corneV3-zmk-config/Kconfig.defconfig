## boards/shields/corneV3-zmk-config/Kconfig.defconfig
```kconfig
if SHIELD_CORNE_V3_DONGLE

config ZMK_KEYBOARD_NAME
    default "Corne V3"

config ZMK_SPLIT_ROLE_CENTRAL
    default y

config ZMK_USB
    default y

endif

if SHIELD_CORNE_V3_LEFT || SHIELD_CORNE_V3_RIGHT

config ZMK_SPLIT
    default y


endif
```
